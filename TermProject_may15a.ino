#include "arduino_secrets.h"

/*
 * Sketch generated by the Arduino IoT Cloud Thing "TermProject"
 * https://create.arduino.cc/cloud/things/1eb539b9-e079-4177-b889-6c5044034706
 */

#include "thingProperties.h"
#include <DHT.h>
#include <WiFi.h>
#include <Wire.h>
#include <Adafruit_GFX.h>
#include <Adafruit_SH110X.h>
#include <ESP32Time.h> // RTC kÃ¼tÃ¼phanesi

#define DHTPIN 4
#define DHTTYPE DHT11
DHT dht(DHTPIN, DHTTYPE);

#define trigPin 5
#define echoPin 18

const int ledPin = 2;
const int buzzerPin = 19;

const int mq7Pin = 34;
const int gasThreshold = 1000;

#define SCREEN_WIDTH 128
#define SCREEN_HEIGHT 64
Adafruit_SH1106G display = Adafruit_SH1106G(SCREEN_WIDTH, SCREEN_HEIGHT, &Wire);

ESP32Time rtc;

bool timeIsSet = false;

int getTurkeyHour() {
  return (rtc.getHour() + 15)%24;
}

int getCurrentMinute() {
  return rtc.getMinute();
}

bool isAlarmTime() {
  if (!timeIsSet) return false;

  int currentHour = getTurkeyHour();
  int currentMinute = getCurrentMinute();

  if (alarmStartTime == alarmEndTime) {
    return true;
  } else if (alarmStartTime < alarmEndTime) {
    return (currentHour > alarmStartTime || (currentHour == alarmStartTime && currentMinute >= 0)) &&
           (currentHour < alarmEndTime || (currentHour == alarmEndTime && currentMinute < 60));
  } else {
    return (currentHour > alarmStartTime || (currentHour == alarmStartTime && currentMinute >= 0)) ||
           (currentHour < alarmEndTime || (currentHour == alarmEndTime && currentMinute < 60));
  }
}

void setup() {
  Serial.begin(115200);
  delay(1500);

  Wire.begin(21, 22);

  initProperties();
  ArduinoCloud.begin(ArduinoIoTPreferredConnection);
  setDebugMessageLevel(2);
  ArduinoCloud.printDebugInfo();

  dht.begin();
  pinMode(trigPin, OUTPUT);
  pinMode(echoPin, INPUT);
  pinMode(ledPin, OUTPUT);
  pinMode(buzzerPin, OUTPUT);
  pinMode(mq7Pin, INPUT);

  digitalWrite(ledPin, ledState);
  digitalWrite(buzzerPin, LOW);

  if (!display.begin(0x3C, true)) {
    Serial.println(F("SH1106 allocation failed"));
    for (;;);
  }
  display.clearDisplay();
  display.setTextSize(1);
  display.setTextColor(SH110X_WHITE);
  display.display();

  Serial.println("RTC BaÅlatÄ±lÄ±yor...");
  // Saati tahmini olarak UTC'ye ayarla (Ã¶rneÄin)
  rtc.setTime(0, 0, 14, 20, 5, 2025); // Saniye, Dakika, Saat (UTC), GÃ¼n, Ay, YÄ±l
  timeIsSet = true;
  Serial.println("RTC tahmini olarak ayarlandÄ± (UTC).");
}

void loop() {
  ArduinoCloud.update();

  if (!timeIsSet && Serial.available()) {
    String dateTime = Serial.readStringUntil('\n');
    if (dateTime.length() >= 19 && dateTime.charAt(4) == '-' && dateTime.charAt(7) == '-' &&
        dateTime.charAt(10) == ' ' && dateTime.charAt(13) == ':' && dateTime.charAt(16) == ':') {
      int year = dateTime.substring(0, 4).toInt();
      int month = dateTime.substring(5, 7).toInt();
      int day = dateTime.substring(8, 10).toInt();
      int hour = dateTime.substring(11, 13).toInt();
      int minute = dateTime.substring(14, 16).toInt();
      int second = dateTime.substring(17, 19).toInt();
      rtc.setTime(second, minute, hour, day, month, year);
      Serial.println("RTC saati ayarlandÄ±: " + rtc.getTime("%Y-%m-%d %H:%M:%S (UTC)"));
      timeIsSet = true;
    } else {
      Serial.println("YanlÄ±Å format. LÃ¼tfen YYYY-MM-DD HH:MM:SS formatÄ±nda girin (UTC).");
    }
  }

  // DHT11 Okuma
  float h = dht.readHumidity();
  float t = dht.readTemperature();
  if (!isnan(h) && !isnan(t)) {
    humidity = h;
    temperature = t;
    highHumidity = (humidity > 60);
    highTemperature = (temperature > 27);
  } else {
    Serial.println("DHT sensÃ¶rÃ¼nden veri okunamadÄ±!");
    highHumidity = false;
    highTemperature = false;
  }

  // HC-SR04 Mesafe ÃlÃ§Ã¼mÃ¼
  long duration;
  digitalWrite(trigPin, LOW);
  delayMicroseconds(2);
  digitalWrite(trigPin, HIGH);
  delayMicroseconds(10);
  digitalWrite(trigPin, LOW);
  duration = pulseIn(echoPin, HIGH);
  distance = duration * 0.034 / 2;
  bool mesafeYakÄ±n = (distance < 30);
  bool alarmZamanÄ± = isAlarmTime();

  if (mesafeYakÄ±n && alarmZamanÄ±) {
    digitalWrite(buzzerPin, HIGH);
    buzzerActive = true;
  } else {
    digitalWrite(buzzerPin, LOW);
    buzzerActive = false;
  }

  // MQ-7 Okuma
  int analogValue = analogRead(mq7Pin);
  gas = analogValue;
  highGas = (gas > gasThreshold);

  // LED Kontrolleri
  if (highTemperature && !ledState) digitalWrite(ledPin, HIGH);
  else if (!highTemperature && ledState && !highHumidity) digitalWrite(ledPin, LOW);
  if (highHumidity && !highTemperature) {
    digitalWrite(ledPin, HIGH);
    delay(1000);
    digitalWrite(ledPin, LOW);
    delay(1000);
  }

  // OLED Ekrana Bilgi YazdÄ±rma
  display.clearDisplay();
  display.setCursor(0, 0);

display.printf("Saat: %02d:%02d:%02d\n", getTurkeyHour() , getCurrentMinute(), rtc.getSecond());

  display.printf("T: %.1f C, H: %.0f %%\n", temperature, humidity);
  display.printf("Mesafe: %d cm\n", distance);
  display.printf("Gaz: %d\n", gas);
  display.printf("Alarm: %d-%d\n", alarmStartTime, alarmEndTime);
  display.printf("Buzzer: %s\n", buzzerActive ? "AKTIF" : "PASIF");
  display.printf("Mesaj: %s\n", message.c_str());
  display.display();

  // Seri MonitÃ¶re YazdÄ±rma (Debug iÃ§in)
  Serial.printf("Saat (TR): %04d-%02d-%02d %02d:%02d:%02d, ", rtc.getYear(), rtc.getMonth(), rtc.getDay(), getTurkeyHour(), getCurrentMinute(), rtc.getSecond());



  Serial.printf("SÄ±caklÄ±k: %.1f Â°C, Nem: %.0f %%, Mesafe: %d cm, Gaz: %d, Buzzer Aktif: %d\n",
                temperature, humidity, distance, gas, buzzerActive);

  
Serial.print("Åu anki saat (TR): ");
  Serial.print(getTurkeyHour());
  Serial.print(":");
  Serial.println(getCurrentMinute());


  Serial.print("Alarm BaÅlangÄ±Ã§: ");
  Serial.print(alarmStartTime);
  Serial.print(", Alarm BitiÅ: ");
  Serial.println(alarmEndTime);
  Serial.print("Alarm ZamanÄ± mÄ±? ");
  Serial.println(isAlarmTime());

  delay(1000);
}

void onLedStateChange() {
  Serial.print("LED Durumu DeÄiÅti: ");
  Serial.println(ledState);
  digitalWrite(ledPin, ledState);
}

void onAlarmStateChange() {
  Serial.print("Alarm Durumu DeÄiÅti (Buluttan): ");
  Serial.println(alarmState);
  
  // Bu deÄiÅken Åu anda doÄrudan buzzer'Ä± kontrol etmiyor.
}

void onMessageChange() {
  Serial.print("Yeni Mesaj AlÄ±ndÄ±: ");
  Serial.println(message);
  display.setCursor(0, 50); // EkranÄ±n alt kÄ±smÄ±na yakÄ±na yazdÄ±rÄ±labilir
  display.print("Mesaj: ");
  display.println(message);
  display.display(); // Ekranda hemen gÃ¼ncellenmesi iÃ§in
}

void onDistanceChange() {
  // Gerekli ama kullanÄ±lmÄ±yor
}

void onGasChange() {
  Serial.print("Gaz Seviyesi DeÄiÅti (Cloud'dan): ");
  Serial.println(gas);
  highGas = (gas > gasThreshold);
}

void onHighGasChange() {
  Serial.print("YÃ¼ksek Gaz Durumu DeÄiÅti (Cloud'dan): ");
  Serial.println(highGas);
}

void onAlarmEndTimeChange()  {
  Serial.print("Alarm BitiÅ Saati DeÄiÅti: ");
  Serial.println(alarmEndTime);
}

void onAlarmStartTimeChange()  {
  Serial.print("Alarm BaÅlangÄ±Ã§ Saati DeÄiÅti: ");
  Serial.println(alarmStartTime);
}